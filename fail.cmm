def main() {
    int int a = 10;

    switch b {
        case 10 * 10:
            b = 20;
            break;
    }

    for int i = 0; i < 1; int i = i + 1 {
        print i;
    }
}

def arrowFunction(a, b) => if 5 > 1 return 10;