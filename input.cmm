def fib(n) {
    if n == 1 return 1;
    if n == 2 return 1;

    return fib(n-1)+fib(n-2);
}
def noargs() {
    a2 = 10;
}
def main() {
    fib(input);
    a = (10 > 5) && (2 < 10);
    int b = 11 + 2;
    float c = 12.22;
    bool d = false;
    while a {
        print fib(input);
        a = a-1;
    }

    for int i = 0; i < 1; i = i + 1 {
        print i;
    }

    switch b {
        case 10:
            print (b + 10) * 50;
            break;
        case 11:
            print b + 20;
            break;
        case 12:
            print b + 30;
            break;
        default:
            print b;
    }

    noargs();

    return 0;
}
def arrowFunction(a, b) => a * b;