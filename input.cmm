def fib(n) {
    if n == 1 return 1;
    if n == 2 return 1;

    return fib(n-1)+fib(n-2);
}
def main() {
    a = 10;
    int b = 11;
    float c = 12.22;
    bool d = false;
    while a {
        print fib(input);
        a = a-1;
    }

    for int i = 0; i < 1; i = i + 1 {
        print i;
    }

    return 0;
}
def arrowFunction(a, b) => a * b;